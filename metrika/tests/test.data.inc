DATA(
    arcadia/metrika/pylib/config/tests/data/xml/config.xml
    arcadia/metrika/pylib/config/tests/data/xml/invalid_xml.xml
    arcadia/metrika/pylib/config/tests/data/xml/from_env_attributes.xml
    arcadia/metrika/pylib/config/tests/data/xml/from_env_or_default.xml
    arcadia/metrika/pylib/config/tests/data/xml/from_env_variables_is_missing.xml
    arcadia/metrika/pylib/config/tests/data/xml/from_yav.xml
    arcadia/metrika/pylib/config/tests/data/xml/from_yav_missing_key_in_secret.xml
    arcadia/metrika/pylib/config/tests/data/xml/from_yav_missing_version.xml
    arcadia/metrika/pylib/config/tests/data/xml/from_yav_invalid_format.xml

    arcadia/metrika/pylib/config/tests/data/yaml/config.yaml
    arcadia/metrika/pylib/config/tests/data/yaml/config_include_missing.yaml
    arcadia/metrika/pylib/config/tests/data/yaml/included_config.yaml
    arcadia/metrika/pylib/config/tests/data/yaml/invalid_yaml.yaml
)

RESOURCE(
    metrika/pylib/config/tests/data/xml/builtin.xml builtin.xml
)
